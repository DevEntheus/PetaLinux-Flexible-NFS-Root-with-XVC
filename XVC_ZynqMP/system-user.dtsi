/include/ "system-conf.dtsi"
/ {
    chosen {
        bootargs = "console=ttyPS0,115200 root=/dev/nfs nfsroot=<NFS Server IP>:/tftpboot/nfsroot/plnx_rootfs,tcp,nfsvers=4 ip=dhcp rw";
	}:
};

&sdhci0 {
       no-1-8-v;
       disable-wp;
};

&sdhci1 {
       no-1-8-v;
       disable-wp;
};

&debug_bridge_0 {
        compatible = "xlnx,xvc";
};
